AUTOSAR XML (schema 00046)
package /SRI_lidar
  sender receiver interface SRI1
    data Object_distance: type=uint16, init-value=7
  sensor actuator sw component type data_lidar_SWC
    provide port Pport_lidar: provided-interface=SRI1
  application sw component type Lidar_ALGO_SWC
    require port RPort_lidar: required-interface=SRI1
